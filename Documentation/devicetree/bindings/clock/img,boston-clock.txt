## Documentation/devicetree/bindings/clock/img,boston-clock.txt
```
Binding for Imagination Technologies MIPS Boston clock sources.

This binding uses the common clock binding[1].

[1] Documentation/devicetree/bindings/clock/clock-bindings.txt

Required properties:
- compatible : Should be "img,boston-clock".
- #clock-cells : Should be set to 1.
  Values available for clock consumers can be found in the header file:
    <dt-bindings/clock/boston-clock.h>
- regmap : Phandle to the Boston platform register system controller.
  This should contain a phandle to the system controller node covering the
  platform registers provided by the Boston board.

Example:

	clk_boston: clock {
		compatible = "img,boston-clock";
		#clock-cells = <1>;
		regmap = <&plat_regs>;
	};

	uart0: uart@17ffe000 {
		/* ... */
		clocks = <&clk_boston BOSTON_CLK_SYS>;
	};
```

## Documentation/devicetree/bindings/net/pch_gbe.txt
```
Intel Platform Controller Hub (PCH) GigaBit Ethernet (GBE)

Required properties:
- compatible:		Should be the PCI vendor & device ID, eg. "pci8086,8802".
- reg:			Should be a PCI device number as specified by the PCI bus
			binding to IEEE Std 1275-1994.
- phy-reset-gpios:	Should be a GPIO list containing a single GPIO that
			resets the attached PHY when active.

Example:

	ethernet@0,1 {
		compatible = "pci8086,8802";
		reg = <0x00020100 0 0 0 0>;
		phy-reset-gpios = <&eg20t_gpio 6
				   GPIO_ACTIVE_LOW>;
	};

	eg20t_gpio: gpio@0,2 {
		compatible = "pci8086,8803";
		reg = <0x00020200 0 0 0 0>;

		gpio-controller;
		#gpio-cells = <2>;
	};
```

## Documentation/devicetree/bindings/timer/ingenic,tcu.txt
```
Ingenic JZ47xx SoCs Timer/Counter Unit devicetree bindings
==========================================================

For a description of the TCU hardware and drivers, have a look at
Documentation/mips/ingenic-tcu.txt.

Required properties:

- compatible: Must be one of:
  * ingenic,jz4740-tcu
  * ingenic,jz4725b-tcu
  * ingenic,jz4770-tcu
- reg: Should be the offset/length value corresponding to the TCU registers
- clocks: List of phandle & clock specifiers for clocks external to the TCU.
  The "pclk", "rtc", "ext" and "tcu" clocks should be provided.
- clock-names: List of name strings for the external clocks.
- #clock-cells: Should be <1>;
  Clock consumers specify this argument to identify a clock. The valid values
  may be found in <dt-bindings/clock/ingenic,tcu.h>.
- interrupt-controller : Identifies the node as an interrupt controller
- #interrupt-cells : Specifies the number of cells needed to encode an
  interrupt source. The value should be 1.
- interrupt-parent : phandle of the interrupt controller.
- interrupts : Specifies the interrupt the controller is connected to.


Children nodes
==========================================================


PWM node:
---------

Required properties:

- compatible: Must be one of:
  * ingenic,jz4740-pwm
  * ingenic,jz4725b-pwm
- #pwm-cells: Should be 3. See ../pwm/pwm.txt for a description of the cell
  format.
- clocks: List of phandle & clock specifiers for the TCU clocks.
- clock-names: List of name strings for the TCU clocks.


Watchdog node:
--------------

Required properties:

- compatible: Must be one of:
  * ingenic,jz4740-watchdog
  * ingenic,jz4780-watchdog
- clocks: phandle to the WDT clock
- clock-names: should be "wdt"


OST node:
---------

Required properties:

- compatible: Must be one of:
  * ingenic,jz4725b-ost
  * ingenic,jz4770-ost
- clocks: phandle to the OST clock
- clock-names: should be "ost"
- interrupts : Specifies the interrupt the OST is connected to.


System timer node:
------------------

Required properties:

- compatible: Must be "ingenic,jz4740-tcu-timer"
- clocks: phandle to the clock of the TCU channel used
- clock-names: Should be "timer"
- interrupts : Specifies the interrupt line of the TCU channel used.


System clocksource node:
------------------------

Required properties:

- compatible: Must be "ingenic,jz4740-tcu-clocksource"
- clocks: phandle to the clock of the TCU channel used
- clock-names: Should be "timer"


Example
==========================================================

#include <dt-bindings/clock/jz4770-cgu.h>
#include <dt-bindings/clock/ingenic,tcu.h>

/ {
	tcu: timer@10002000 {
		compatible = "ingenic,jz4770-tcu";
		reg = <0x10002000 0x1000>;
		#address-cells = <1>;
		#size-cells = <1>;
		ranges = <0x0 0x10002000 0x1000>;

		#clock-cells = <1>;

		clocks = <&cgu JZ4770_CLK_RTC
			  &cgu JZ4770_CLK_EXT
			  &cgu JZ4770_CLK_PCLK
			  &cgu JZ4770_CLK_EXT>;
		clock-names = "rtc", "ext", "pclk", "tcu";

		interrupt-controller;
		#interrupt-cells = <1>;

		interrupt-parent = <&intc>;
		interrupts = <27 26 25>;

		watchdog: watchdog@0 {
			compatible = "ingenic,jz4740-watchdog";
			reg = <0x0 0xc>;

			clocks = <&tcu TCU_CLK_WDT>;
			clock-names = "wdt";
		};

		timer: timer@40 {
			compatible = "ingenic,jz4740-tcu-timer";
			reg = <0x40 0x10>;

			clocks = <&tcu TCU_CLK_TIMER0>;
			clock-names = "timer";

			interrupts = <0>;
		};

		clocksource: timer@50 {
			compatible = "ingenic,jz4740-tcu-clocksource";
			reg = <0x50 0x10>;

			clocks = <&tcu TCU_CLK_TIMER1>;
			clock-names = "timer";

			/* Disable by default, since the OST is more precise */
			status = "disabled";
		};

		pwm: pwm@60 {
			compatible = "ingenic,jz4740-pwm";
			reg = <0x60 0x60>;

			#pwm-cells = <3>;

			clocks = <&tcu TCU_CLK_TIMER0
				  &tcu TCU_CLK_TIMER1
				  &tcu TCU_CLK_TIMER2
				  &tcu TCU_CLK_TIMER3
				  &tcu TCU_CLK_TIMER4
				  &tcu TCU_CLK_TIMER5
				  &tcu TCU_CLK_TIMER6
				  &tcu TCU_CLK_TIMER7>;
			clock-names = "timer0", "timer1", "timer2", "timer3",
				      "timer4", "timer5", "timer6", "timer7";
		};

		ost: timer@e0 {
			compatible = "ingenic,jz4770-ost";
			reg = <0xe0 0x20>;

			clocks = <&tcu TCU_CLK_OST>;
			clock-names = "ost";

			interrupts = <15>;
		};
	};
};
```
